// This file was generated from a template. Edit it to match your keyboard.
// See https://zmk.dev/docs/development/hardware-integration/new-shield for more
// instructions.

#include "corne_ulp_ball.dtsi"
#include <dt-bindings/zmk/input_transform.h>

&xiao_i2c {
    status = "okay";
    clock-frequency = <I2C_BITRATE_FAST>;
    trackball: trackball@a {
        compatible = "palette,az1uball";
        reg = <0x0A>;
        automouse-layer = <1>;
		status = "okay";
    };
};

&trackball_input_listener_0 {
    status = "okay";
    device = <&trackball>;
    input-processors = <&zip_xy_scaler 8 8>,<&zip_xy_transform (INPUT_TRANSFORM_XY_SWAP)>;
};

&trackball_input_listener_1 {
    status = "okay";
};
