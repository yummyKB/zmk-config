// This file was generated from a template. Edit it to match your keyboard.
// See https://zmk.dev/docs/development/hardware-integration/new-shield for more
// instructions.

#include "corne_ulp_ball.dtsi"

&default_transform {
    // Set this to the number of columns on the left side.
    col-offset = <6>;
};
