## boards/shields/corne_ulp_ball/Kconfig.defconfig
```kconfig
if SHIELD_CORNE_ULP_BALL_LEFT

config ZMK_KEYBOARD_NAME
    default "Corne ULP Ball L"

config ZMK_SPLIT_ROLE_CENTRAL
    default y

config ZMK_STUDIO
    default y

endif # SHIELD_CORNE_ULP_BALL_LEFT

if SHIELD_CORNE_ULP_BALL_RIGHT

config ZMK_KEYBOARD_NAME
    default "Corne ULP Ball R"

endif # SHIELD_CORNE_ULP_BALL_RIGHT

if SHIELD_CORNE_ULP_BALL_LEFT || SHIELD_CORNE_ULP_BALL_RIGHT

config ZMK_SPLIT
    default y

config SPI
    default y

config ZMK_POINTING
    default y

config AZ1UBALL
    default y

config I2C
    default y

config BT_CTLR_TX_PWR_PLUS_8
    default y

config ZMK_SPLIT_BLE_CENTRAL_BATTERY_LEVEL_PROXY
    default y

config ZMK_SPLIT_BLE_CENTRAL_BATTERY_LEVEL_FETCHING
    default y

config BT_BAS
    default n

endif # SHIELD_CORNE_ULP_BALL_LEFT || SHIELD_CORNE_ULP_BALL_RIGHT
```

## boards/shields/corne_ulp_ball/Kconfig.shield
```kconfig
config SHIELD_CORNE_ULP_BALL_LEFT
    def_bool $(shields_list_contains,corne_ulp_ball_left)

config SHIELD_CORNE_ULP_BALL_RIGHT
    def_bool $(shields_list_contains,corne_ulp_ball_right)
```

## config/west.yml
```yaml
manifest:
  remotes:
    - name: zmkfirmware
      url-base: https://github.com/zmkfirmware
    - name: kzyz
      url-base: https://github.com/kzyz
  projects:
    - name: zmk
      remote: zmkfirmware
      revision: main
      import: app/west.yml
    - name: zmk_az1uball_driver
      remote: kzyz
      revision: main
  self:
    path: config
```
